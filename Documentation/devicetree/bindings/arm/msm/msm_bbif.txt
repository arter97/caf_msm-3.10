## Documentation/devicetree/bindings/arm/msm/msm_bbif.txt
```
QTI Base Band InterFace (BBIF)

This is a platform driver for accessing the DAC/ADCs in femto (FSM9900
and FSM9010) chipsets.

Required properties:

-compatible: should be "qcom,bbif-fsm9900" or "qcom,bbif-fsm9010"
-reg: specifies the base address of bbif registers. Also, specifies
fuse register address for fsm9010 only.
-reg-names: The names given to the memory bank locations
-clocks: clock identifers used by clock driver while looking up DAC/ADC clocks.
-clock-names: name of the clock used by bbif driver.

Optional properties:

vdd-lbbrx-supply: regulator used to control low voltage of Base Band RX.
vdd-hbbrx-supply: regulator used to control high voltage of Base Band RX.

Example 1:
	qcom,bbif@fd300000 {
		compatible = "qcom,bbif-fsm9900";
		reg = <0xfd300000 0x10000>;
		vdd-lbbrx-supply = <&pma8084_l4>;
		vdd-hbbrx-supply = <&pma8084_l14>;
	};

Example 2:
	qcom,bbif@fd300000 {
		compatible = "qcom,bbif-fsm9010";
		reg-names = "bbif_base", "bbif_fuse";
		reg = <0xfd300000 0x10000>,
			<0xfc4b80d8 0x100>;
		clocks = <&clock_gcc clk_gcc_bbif_adc0_clk>,
			<&clock_gcc clk_gcc_bbif_adc1_clk>,
			<&clock_gcc clk_gcc_bbif_adc2_clk>,
			<&clock_gcc clk_gcc_bbif_adc3_clk>,
			<&clock_gcc clk_gcc_bbif_adc4_clk>,
			<&clock_gcc clk_gcc_bbif_dac0_clk>,
			<&clock_gcc clk_gcc_bbif_dac1_clk>,
			<&clock_gcc clk_gcc_bbif_dac2_clk>,
			<&clock_gcc clk_gcc_bbif_dac3_clk>;
		clock-names = "bbif_adc0_clk", "bbif_adc1_clk", "bbif_adc2_clk",
			"bbif_adc3_clk", "bbif_adc4_clk", "bbif_dac0_clk",
			"bbif_dac1_clk","bbif_dac2_clk","bbif_dac3_clk";
	};
```

## Documentation/devicetree/bindings/arm/msm/msm_rfic.txt
```
QTI Radio Frequency IC (RFIC)

This is a kernel platform driver which enables the RF interfaces supported by
QTI. This driver uses SSBI driver to access the low level registers. This has
support for Pulse Density Modulation(PDM) and General purpose RF Control(GRFC)s.
It is also possible to access GRFC without going through SSBI. There are 2
sections listed below, one using ssbi parent driver and the other direct access.

1. Driver access to get/set GRFC registers using ssbi driver.

Required properties:
-compatible: parent should be "qcom,ssbi"
-reg: physical base address and length of the register set
-reg-names: RFIC device is a child node of ssbi and uses the base address of
the parent driver. RFIC uses a large set of registers, hence base address is
defined here.
-qcom,controller-type: controller type could be "geni-ssbi-arbiter" or
"geni-ssbi2-arbiter"
-compatible: child should be "qcom,rfic-fsm9900" or "qcom,rfic-fsm9010"

Example for rfic driver using SSBI as a parent:
	ssbi1:  qcom,ssbi@f9b18000 {
		compatible = "qcom,ssbi";
		reg = <0xf9b18000 0x4000>;
		reg-names = "ssbi1_base";
		qcom,controller-type = "geni-ssbi-arbiter";

		rfic@1 {
			compatible = "qcom,rfic-fsm9900", "qcom,rfic-fsm9010";
		};
	};

2. Driver access to set/get GRFC registers without going thru SSBI. The following
driver entry is independent and does not use ssbi driver.

Required properties:
-compatible: should be "qcom,rfic-fsm9900" or "qcom,rfic-fsm9010"
-reg: specifies the base address of the GRFC registers.

- pinctrl-states: names of pinctrl states that are used by the driver to
	configure TLMM pins. States required by fsm9900 are "default",
	"mdm_m", "mdm_k" and "mdm_g". The "default" state selects the pin
	configuration required for probing the RF board while the remaining
	states select appropriate grfc pins specific to the detected RF board.
	Rfic driver for fsm9010 uses only a single state "default" that sets
	all the required grfc pins.

- pinctrl-#: a list of pinctrl phandles for the different pinctrl states. Refer
	to "Documentation/devicetree/bindings/pinctrl/pinctrl-bindings.txt" for the
	pinctrl handles definitions. Each pinctrl-# corresponds to the respective
	state name that appears under pinctrl-state list.

Optional properties:
vdd-switch-supply: regulator used to control RF switches.
vdd-wtr-supply: regulator used to control WTR.
vdd-ftr1-supply: regulator used to control FTR1.
vdd-ftr2-supply: regulator used to control FTR2.
vdd-1v8-supply: regulator used to control 1.8V to all RFICs.
vdd-1v3-supply: regulator used to control 1.3V to all RFICs

- clocks: clock identifers used by clock driver while looking up pdm clocks.
- clock-names: name of the clock used by rfic driver.

rfic driver uses 3 resources as mentioned below in reg entry and resources
are exttracted using array number by platform_get_resource().

Example 1:
	qcom,rfic@fd4a4090 {
		compatible = "qcom,rfic-fsm9900";
		reg = <0xfd4a4090 0x40>,
			<0x3a000000 0xa00000>,
			<0xf9b10000 0x8000>;

		reg = <0xfd4a4090 0x40>;
		vdd-switch-supply = <&pma8084_l18>;
		vdd-wtr-supply = <&pma8084_l19>;
		vdd-ftr1-supply = <&pma8084_l23>;
		vdd-ftr2-supply = <&pma8084_l25>;
		vdd-1v8-supply = <&pma8084_l26>;
		vdd-1v3-supply = <&pma8084_l11>;
		pinctrl-names = "default", "mdm_m", "mdm_k", "mdm_g";
		pinctrl-0 = <&rf_detect_active>;
		pinctrl-1 = <&mdm_m_grfc_f1_active>;
		pinctrl-2 = <&mdm_k_grfc_f2_active &mdm_k_grfc_f3_active>;
		pinctrl-3 = <&mdm_g_grfc_f2_active>;
	};

	qcom,pdm@f9b10000 {
		compatible = "qcom,rfic-fsm9900";
		reg = <0xf9b10000 0x8000>;
	};

Example 2:
	qcom,rfic@fd4a4090 {
		compatible = "qcom,rfic-fsm9010";
		reg = <0xfd4a4090 0x40>,
			<0x29000000 0xa00000>,
			<0xf9b10000 0x8000>,
			<0xfd510000 0x4000>;
		clocks = <&clock_gcc clk_gcc_pdm2_clk>,
			<&clock_gcc clk_gcc_pdm2_ahb_clk>;
		clock-names = "pdm2_clk", "ahb_clk";
		pinctrl-names = "default";
		pinctrl-0 = <&rf_ssbi_default>;
	};

	qcom,pdm@f9b10000 {
		compatible = "qcom,rfic-fsm9010";
		reg = <0xf9b10000 0x8000>;
	};
```

## Documentation/devicetree/bindings/net/danipc.txt
```
Qualcomm Technologies Inc. DANIPC driver

This is a kernel driver which makes use of DAN IPC hardware module.
DAN IPC is an inter-processor communication network which provides facilities
for fast and reliable data passing between processors.

Required properties:
- compatible:	should be "qcom,danipc"
- reg-names:	"ipc_bufs" - APPS IPC buffers region
		"mem_map" - Flexible memory map region
		"agent_table" - IPC global agent table region
		"apps_ipc_intr_en" - APPS IPC interrupt enable MUX region
		"phycpu0_ipc" - PHY CPU0 IPC region
		"phycpu1_ipc" - PHY CPU1 IPC region
		"phycpu2_ipc" - PHY CPU2 IPC region
		"phycpu3_ipc" - PHY CPU3 IPC region
		"phydsp0_ipc" - PHY DSP0 IPC region
		"phydsp1_ipc" - PHY DSP1 IPC region
		"phydsp2_ipc" - PHY DSP2 IPC region
		"apps_ipc" - APPS IPC region
		"qdsp6_0_ipc" - QDSP6 0 IPC region
		"qdsp6_1_ipc" - QDSP6 1 IPC region
		"qdsp6_2_ipc" - QDSP6 2 IPC region
		"qdsp6_3_ipc" - QDSP6 3 IPC region
		"apps_ipc_pcap" - APPS IPC region for PCAP
- reg:		location and size of APPS IPC buffers
		location and size of IPC global agent table
		location and size of APPS IPC interrupt enable MUX
		location and size of PHY CPU0 IPC region
		location and size of PHY CPU1 IPC region
		location and size of PHY CPU2 IPC region
		location and size of PHY CPU3 IPC region
		location and size of PHY DSP0 IPC region
		location and size of PHY DSP1 IPC region
		location and size of PHY DSP2 IPC region
		location and size of APPS IPC region
		location and size of QDSP6 0 IPC region
		location and size of QDSP6 1 IPC region
		location and size of QDSP6 2 IPC region
		location and size of QDSP6 3 IPC region
		location and size of PHY PCAP IPC region
- interrupts:	IPC interrupt line

Optional properties:
	-qcom,phycpu0-shm-size: size of shared memory region for PHY CPU0
	-qcom,phycpu1-shm-size: size of shared memory region for PHY CPU1
	-qcom,phycpu2-shm-size: size of shared memory region for PHY CPU2
	-qcom,phycpu3-shm-size: size of shared memory region for PHY CPU3
	-qcom,phydsp0-shm-size: size of shared memory region for PHY DSP0
	-qcom,phydsp1-shm-size: size of shared memory region for PHY DSP1
	-qcom,phydsp2-shm-size: size of shared memory region for PHY DSP2
	-qcom,apps-shm-size: size of shared memory region for APPS
	-qcom,qdsp6-0-shm-size: size of shared memory region for QDSP6 0
	-qcom,qdsp6-1-shm-size: size of shared memory region for QDSP6 1
	-qcom,qdsp6-2-shm-size: size of shared memory region for QDSP6 2
	-qcom,qdsp6-3-shm-size: size of shared memory region for QDSP6 3

Note:
Either mem_map or ipc_bufs must be specified, not both.  If mem_map
is specified, the *shm-size properties are ignored.


Examples:
	qcom,danipc@0xfe803c00 {
		compatible = "qcom,danipc";
		reg-names = "mem_map", "agent_table", "apps_ipc_intr_en",
			"phycpu0_ipc", "phycpu1_ipc", "phycpu2_ipc",
			"phycpu3_ipc", "phydsp0_ipc", "phydsp1_ipc",
			"phydsp2_ipc", "apps_ipc_data",
			"qdsp6_0_ipc", "qdsp6_1_ipc", "qdsp6_2_ipc",
			"qdsp6_3_ipc", "apps_ipc_pcap" ;
		reg = <0xfe803c00 0x400>, /* mem_map */
			<0x19d00000 0x80000>, /* agent_table */
			<0xfd4a3500 0x100>, /* apps_ipc_intr_en */
			<0xf683a000 0x100>, /* phycpu0_ipc */
			<0xf683a000 0x100>, /* phycpu1_ipc */
			<0xf683c000 0x100>, /* phycpu2_ipc */
			<0xf683c000 0x100>, /* phycpu3_ipc */
			<0xf6862000 0x100>, /* phydsp0_ipc */
			<0xf6862000 0x100>, /* phydsp1_ipc */
			<0xf6878000 0x100>, /* phydsp2_ipc */
			<0xfd490000 0x100>, /* apps_ipc_data */
			<0xfd491000 0x100>, /* qdsp6_0_ipc */
			<0xfd492000 0x100>, /* qdsp6_1_ipc */
			<0xfd496000 0x100>, /* qdsp6_2_ipc */
			<0xfd494000 0x100>, /* qdsp6_3_ipc */
			<0xfd487000 0x100>; /* apps_ipc_pcap */
		interrupts = <0 202 0>, <0 203 0>;
	};

	qcom,danipc@22000000 {
		compatible = "qcom,danipc";
		reg-names = "ipc_bufs", "agent_table", "apps_ipc_intr_en",
			"phycpu0_ipc", "phycpu1_ipc", "phycpu2_ipc",
			"phydsp0_ipc", "phydsp1_ipc", "apps_ipc_data",
			"qdsp6_0_ipc", "qdsp6_1_ipc", "apps_ipc_pcap";
		reg = <0x22000000 0x100000>, /* ipc_bufs */
			<0x13e60000 0x2000>, /* agent_table */
			<0xfd4a3500 0x100>, /* apps_ipc_intr_en */
			<0xf683a000 0x100>, /* phycpu0_ipc */
			<0xf683a000 0x100>, /* phycpu1_ipc */
			<0xf683c000 0x100>, /* phycpu2_ipc */
			<0xf683c000 0x100>, /* phydsp0_ipc */
			<0xf6862000 0x100>, /* phydsp1_ipc */
			<0xfd490000 0x100>, /* apps_ipc_data */
			<0xfd491000 0x100>, /* qdsp6_0_ipc */
			<0xfd496000 0x100>, /* qdsp6_1_ipc */
			<0xfd487000 0x100>; /* apps_ipc_pcap */
		qcom,qdsp6-1-shm-size = <0x2000000>;
		interrupts = <0 202 0>, <0 203 0>;
	};
```
