/* Copyright (c) 2014, The Linux Foundation. All rights reserved.
 *
 * This program is free software; you can redistribute it and/or modify
 * it under the terms of the GNU General Public License version 2 and
 * only version 2 as published by the Free Software Foundation.
 *
 * This program is distributed in the hope that it will be useful,
 * but WITHOUT ANY WARRANTY; without even the implied warranty of
 * MERCHANTABILITY or FITNESS FOR A PARTICULAR PURPOSE.  See the
 * GNU General Public License for more details.
 */

/dts-v1/;

#include "apq8084-v1.1.dtsi"
#include "apq8084-lucas2.dtsi"

/ {
	model = "Lucas2 APQ 8084 v1.1";
        compatible = "qcom,apq8084-lucas2", "qcom,apq8084", "qcom,lucas2";
        qcom,board-id = <25 0>;
};
